## examples/RBGWstrandtest/main/Kconfig.projbuild
```kconfig
menu "ESP32_snow led_strip Configuration"

config LED_STRIP_GPIO_PIN
    int "Pin controlling LED strip"
    range -1 33
    default 5
    help
        Select LED pin or -1 for unmanaged.

config LED_STRIP_NUM_PIXELS
		int "Pin controlling LED strip"
    range 0 255
    default 5
    help
        Select number of pixels in strand.

config RMT_CHANNEL
int "Pin controlling LED strip"
    range 0 7
    default 1
    help
        Select ESP32 RMT channel number.

endmenu
```
